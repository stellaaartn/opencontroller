## sdkconfig.defaults
```kconfig
# WiFi
CONFIG_ESP32_WIFI_ENABLED=y
CONFIG_ESP_WIFI_STATIC_RX_BUFFER_NUM=10
CONFIG_ESP_WIFI_DYNAMIC_RX_BUFFER_NUM=32

# TCP/IP
CONFIG_LWIP_MAX_SOCKETS=16

# HTTP server
CONFIG_HTTPD_MAX_REQ_HDR_LEN=1024
CONFIG_HTTPD_MAX_URI_LEN=512

# NVS
CONFIG_NVS_FLASH=y

# Logging
CONFIG_LOG_DEFAULT_LEVEL_INFO=y
```
